$SAVE
$NOLIST
$NOSYMLIST
;/* (c) Copyright KEIL ELEKTRONIK GmbH.  1996, All rights reserved. */
;/* 8xC251A1 Processor Declarations */
;
; BYTE Registers
P0      DATA    80H
P1      DATA    90H
P2      DATA    0A0H
P3      DATA    0B0H
PSW     DATA    0D0H
PSW1	DATA	0D1H
ACC     DATA    0E0H
B       DATA    0F0H
SP      DATA    081H
SPH	DATA	0BDH
DPL     DATA    82H
DPH     DATA    83H
DPXL	DATA	84H
PCON    DATA    87H
TCON    DATA    88H
TMOD    DATA    89H
TL0     DATA    8AH
TL1     DATA    8BH
TH0     DATA    8CH
TH1     DATA    8DH
IE0     DATA    0A8H
IPL0    DATA    0B8H
IPH0	DATA	0B7H
IE1	DATA	0B1H
IPL1	DATA	0B2H
IPH1	DATA	0B3H
SCON    DATA    98H
SBUF    DATA    99H
SADDR   DATA    0A9H
SADEN   DATA    0B9H
CCON    DATA    0D8H
CMOD    DATA    0D9H
CCAPM0  DATA    0DAH
CCAPM1  DATA    0DBH
CCAPM2  DATA    0DCH
CCAPM3  DATA    0DDH
CCAPM4  DATA    0DEH
CL      DATA    0E9H
CCAP0L  DATA    0EAH
CCAP1L  DATA    0EBH
CCAP2L  DATA    0ECH
CCAP3L  DATA    0EDH
CCAP4L  DATA    0EEH
CH      DATA    0F9H
CCAP0H  DATA    0FAH
CCAP1H  DATA    0FBH
CCAP2H  DATA    0FCH
CCAP3H  DATA    0FDH
CCAP4H  DATA    0FEH
WDTRST	DATA	0A6H
PFLT   	DATA	086H
CKRL   	DATA	08EH
POWM   	DATA	08FH
SBRG0  	DATA	092H
SCTL0  	DATA	093H
STAT0  	DATA	094H
SDAT0  	DATA	095H
TBAM   	DATA	097H
BRL    	DATA	09AH
BDR    	DATA	09BH
PER0   	DATA	0A2H
WID0   	DATA	0A3H
PER1   	DATA	0A4H
WID1   	DATA	0A5H
PER2   	DATA	0A6H
WID2   	DATA	0A7H
PMP0   	DATA	0AAH
PMP1   	DATA	0ABH
PMP2   	DATA	0ACH
PMCR   	DATA	0ADH
PMS	DATA	0AEH
ADCON  	DATA	0C5H
ADAT   	DATA	0C6H
SBRG1  	DATA	0D2H
SCTL1  	DATA	0D3H
STAT1  	DATA	0D4H
SDAT1  	DATA	0D5H
CMOD0  	DATA	0DFH
COF	DATA	0E1H
CRC	DATA	0E2H
ECF	DATA	0E3H
CL1	DATA	0E4H
CL2	DATA	0E5H
CL3	DATA	0E6H
CL4	DATA	0E7H
CMOD1  	DATA	0EFH
CH1	DATA	0F4H
CH2	DATA	0F5H
CH3	DATA	0F6H
CH4	DATA	0F7H
CMOD2  	DATA	0FFH

; BIT Registers
; PSW
CY      BIT     0D7H
AC      BIT     0D6H
F0      BIT     0D5H
RS1     BIT     0D4H
RS0     BIT     0D3H
OV      BIT     0D2H
P       BIT     0D0H
; TCON
TF1     BIT     8FH
TR1     BIT     8EH
TF0     BIT     8DH
TR0     BIT     8CH
IE1_    BIT     8BH
IT1     BIT     8AH
IE0_    BIT     89H
IT0     BIT     88H
; IE
EA      BIT     0AFH
EC      BIT     0AEH
ADC     BIT     0ADH
ES      BIT     0ACH
ET1     BIT     0ABH
EX1     BIT     0AAH
ET0     BIT     0A9H
EX0     BIT     0A8H
; IPL0
PPC     BIT     0BEH
PT2     BIT     0BDH
PS      BIT     0BCH
PT1     BIT     0BBH
PX1     BIT     0BAH
PT0     BIT     0B9H
PX0     BIT     0B8H
; P3
RD      BIT     0B7H
WR      BIT     0B6H
T1      BIT     0B5H
T0      BIT     0B4H
INT1    BIT     0B3H
INT0    BIT     0B2H
TXD     BIT     0B1H
RXD     BIT     0B0H
; SCON
FE      BIT     9FH
SM0     BIT     9FH
SM1     BIT     9EH
SM2     BIT     9DH
REN     BIT     9CH
TB8     BIT     9BH
RB8     BIT     9AH
TI      BIT     99H
RI      BIT     98H
; P1
CEX4    BIT     97H
CEX3    BIT     96H
CEX2    BIT     95H
CEX1    BIT     94H
CEX0    BIT     93H
ECI     BIT     92H
T2EX    BIT     91H
T2      BIT     90H
; T2CON
TF2     BIT     0CFH
EXF2    BIT     0CEH
RCLK    BIT     0CDH
TCLK    BIT     0CCH
EXEN2   BIT     0CBH
TR2     BIT     0CAH
C_T2    BIT     0C9H
CP_RL2  BIT     0C8H
; CCON
CF      BIT     0DFH
CR      BIT     0DEH
CCF4    BIT     0DCH
CCF3    BIT     0DBH
CCF2    BIT     0DAH
CCF1    BIT     0D9H
CCF0    BIT     0D8H
$RESTORE
